#include "oled_graphics.h"
#include <string.h>
#include <stdlib.h>

static uint8_t framebuffer[OLED_BUFFER_SIZE];

/* Standard 5x7 ASCII font table (ASCII 32 ' ' to 126 '~') */
static const uint8_t font_5x7[95][5] = {
    {0x00, 0x00, 0x00, 0x00, 0x00}, /* ' ' */
    {0x00, 0x00, 0x5F, 0x00, 0x00}, /* '!' */
    {0x00, 0x07, 0x00, 0x07, 0x00}, /* '"' */
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    {0x08, 0x08, 0x2A, 0x1C, 0x08}  /* '~' */
};

void oled_clear(oled_color_t color)
{
    uint8_t fill = (color == COLOR_WHITE) ? 0xFF : 0x00;
    memset(framebuffer, fill, sizeof(framebuffer));
}

void oled_set_pixel(int x, int y, oled_color_t color)
{
    if (x < 0 || x >= OLED_WIDTH || y < 0 || y >= OLED_HEIGHT) {
        return;
    }

    int index = x + (y / 8) * OLED_WIDTH;
    uint8_t mask = 1U << (y % 8);

    switch (color) {
        case COLOR_WHITE:
            framebuffer[index] |= mask;
            break;
        case COLOR_BLACK:
            framebuffer[index] &= ~mask;
            break;
        case COLOR_INVERT:
            framebuffer[index] ^= mask;
            break;
    }
}

uint8_t oled_get_pixel(int x, int y)
{
    if (x < 0 || x >= OLED_WIDTH || y < 0 || y >= OLED_HEIGHT) {
        return 0;
    }
    return (framebuffer[x + (y / 8) * OLED_WIDTH] >> (y % 8)) & 0x01;
}

void oled_draw_line(int x0, int y0, int x1, int y1, oled_color_t color)
{
    int dx = abs(x1 - x0);
    int sx = x0 < x1 ? 1 : -1;
    int dy = -abs(y1 - y0);
    int sy = y0 < y1 ? 1 : -1;
    int err = dx + dy;

    while (1) {
        oled_set_pixel(x0, y0, color);
        if (x0 == x1 && y0 == y1) break;
        int e2 = 2 * err;
        if (e2 >= dy) {
            err += dy;
            x0 += sx;
        }
        if (e2 <= dx) {
            err += dx;
            y0 += sy;
        }
    }
}

void oled_draw_rect(int x, int y, int w, int h, oled_color_t color)
{
    if (w <= 0 || h <= 0) return;
    oled_draw_line(x, y, x + w - 1, y, color);
    oled_draw_line(x, y + h - 1, x + w - 1, y + h - 1, color);
    oled_draw_line(x, y, x, y + h - 1, color);
    oled_draw_line(x + w - 1, y, x + w - 1, y + h - 1, color);
}

void oled_fill_rect(int x, int y, int w, int h, oled_color_t color)
{
    if (w <= 0 || h <= 0) return;
    for (int i = 0; i < h; i++) {
        oled_draw_line(x, y + i, x + w - 1, y + i, color);
    }
}

void oled_draw_circle(int cx, int cy, int r, oled_color_t color)
{
    int x = 0;
    int y = r;
    int d = 3 - 2 * r;

    while (y >= x) {
        oled_set_pixel(cx + x, cy + y, color);
        oled_set_pixel(cx - x, cy + y, color);
        oled_set_pixel(cx + x, cy - y, color);
        oled_set_pixel(cx - x, cy - y, color);
        oled_set_pixel(cx + y, cy + x, color);
        oled_set_pixel(cx - y, cy + x, color);
        oled_set_pixel(cx + y, cy - x, color);
        oled_set_pixel(cx - y, cy - x, color);

        if (d < 0) {
            d = d + 4 * x + 6;
        } else {
            d = d + 4 * (x - y) + 10;
            y--;
        }
        x++;
    }
}

void oled_fill_circle(int cx, int cy, int r, oled_color_t color)
{
    int x = 0;
    int y = r;
    int d = 3 - 2 * r;

    while (y >= x) {
        oled_draw_line(cx - x, cy + y, cx + x, cy + y, color);
        oled_draw_line(cx - x, cy - y, cx + x, cy - y, color);
        oled_draw_line(cx - y, cy + x, cx + y, cy + x, color);
        oled_draw_line(cx - y, cy - x, cx + y, cy - x, color);

        if (d < 0) {
            d = d + 4 * x + 6;
        } else {
            d = d + 4 * (x - y) + 10;
            y--;
        }
        x++;
    }
}

void oled_draw_char(int x, int y, char c, oled_color_t color)
{
    unsigned char ch = (unsigned char)c;
    if (ch < 32 || ch > 126) {
        ch = '?';
    }

    const uint8_t *glyph = font_5x7[ch - 32];
    for (int col = 0; col < 5; col++) {
        uint8_t bits = glyph[col];
        for (int row = 0; row < 7; row++) {
            if (bits & (1U << row)) {
                oled_set_pixel(x + col, y + row, color);
            }
        }
    }
}

void oled_draw_text(int x, int y, const char *text, oled_color_t color)
{
    int cur_x = x;
    int cur_y = y;

    while (*text) {
        if (*text == '\n') {
            cur_x = x;
            cur_y += 8;
        } else {
            oled_draw_char(cur_x, cur_y, *text, color);
            cur_x += 6; // 5 pixels width + 1 pixel spacing
        }
        text++;
    }
}

void oled_draw_bitmap(int x, int y, int w, int h, const uint8_t *bitmap, oled_color_t color)
{
    if (!bitmap || w <= 0 || h <= 0) return;
    int byte_width = (w + 7) / 8;
    for (int row = 0; row < h; row++) {
        for (int col = 0; col < w; col++) {
            int byte_idx = row * byte_width + (col / 8);
            uint8_t bit_mask = 0x80 >> (col % 8);
            if (bitmap[byte_idx] & bit_mask) {
                oled_set_pixel(x + col, y + row, color);
            }
        }
    }
}

uint8_t* oled_get_framebuffer(void)
{
    return framebuffer;
}

